#include <SPI.h>
#include <WiFly.h>
#include <avr/pgmspace.h>
#define DELAY 100
#define SPEED 20

char passphrase[] = "WIFI_PASSWORD";
char ssid[] = "WIFI_NAME";

const int clockPin = 4;  //13
const int dataPin = 3;   //11
const int latchPin = 2;  //10

String tweetBuffer;

//byte arrow[8]={0x18,0x3C,0x66,0xDB,0x18,0x18,0x18,0x18};
byte displayBuffer[8]= {0};
  
prog_uchar fontDefinitions[475] PROGMEM = {
0x00,0x00,0x00,0x00,0x00,/*space*/ // is 32 in ASCII
0x00,0xF6,0xF6,0x00,0x00,/*!*/
0x00,0xE0,0x00,0xE0,0x00,/*"*/
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0x00,0x00,0x06,0x06,0x00,/*.*/
0x02,0x0C,0x10,0x60,0x80,/*/*/
0x7C,0x8A,0x92,0xA2,0x7C,/*0*/
0x00,0x42,0xFE,0x02,0x00,/*1*/
0x42,0x86,0x8A,0x92,0x62,/*2*/
0x44,0x82,0x92,0x92,0x6C,/*3*/
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0x00,0x10,0x6C,0x82,0x82,/*{*/
//0x00,0x00,0xFF,0x00,0x00,/*|*/
0x04,0x02,0xFF,0x02,0x04,/*|, arrow*/
0x82,0x82,0x6C,0x10,0x00,/*}*/
0x08,0x10,0x18,0x08,0x10/*~*/
};



WiFlyClient client("simpletwitter.herokuapp.com", 80);

void setup() {
  pinMode(clockPin, OUTPUT);
  pinMode(dataPin, OUTPUT);
  pinMode(latchPin, OUTPUT);

  Serial.begin(115200);
  WiFly.begin();
  
  if (!WiFly.join(ssid, passphrase)) {
    Serial.println("Association failed.");
    while (1); // Hang on failure.
  }  

  
}

void loop() {
  getTweetsToBuffer();
  //Serial.println(sBuffer);
  
  for(int i=0; i<5; i++) {
      newTweetTone();
      delay(1000);
      //Serial.println(tweet);
      //delay(1000);
      //displayTweet();
      displayTweet(getTweetfromBody(i));
      addSpace();
    }
  
  //displayString("This is a scrolling LED matrix display. You can easily make your own! ", 70);
}

void scrollBufferLeft() {
  for(int i=7; i>=0; i--) {
    displayBuffer[i+1] = displayBuffer[i];
  }
}

void addCharSliceToBuffer(byte c, byte pos) {
  displayBuffer[0] = pgm_read_byte_near(fontDefinitions + ((c - 32) * 5) + pos);
}

void displayTweet(String displayString) {
  for(int k = 0; k < displayString.length(); k++) {
    for(int j = 0; j < 5; j++) {
      addCharSliceToBuffer(displayString[k], j);
      for(int i=0; i < SPEED; i++) drawImage(displayBuffer);
      scrollBufferLeft();
    }
     addCharSliceToBuffer(' ', 0);
     for(int i=0; i < SPEED; i++) drawImage(displayBuffer);
     scrollBufferLeft();
  }
}

void addSpace() {
      for(int j=0; j<16; j++) {
        addCharSliceToBuffer(' ', 0);
        for(int i=0; i < SPEED; i++) drawImage(displayBuffer);
        scrollBufferLeft();
      }
}

void drawImage(byte * matrix) {
  for(int i=0; i<8; i++) {
    for(int j=0; j<8; j++) { 
      digitalWrite(clockPin, LOW);
      digitalWrite(dataPin, (matrix[i]) & (1<<j) );
      digitalWrite(clockPin, HIGH);
    }
    
    for(int j=7; j>=0; j--) { 
      digitalWrite(clockPin, LOW);
      digitalWrite(dataPin, (~(1<<i)) & (1<<j) );
      digitalWrite(clockPin, HIGH);
    }

    digitalWrite(latchPin,LOW);
    digitalWrite(latchPin,HIGH);
  } 
}


void getTweetsToBuffer() {
  
  Serial.println("Getting tweets...");

  if (client.connect()) {
    Serial.println("Connected.");
    client.println("GET / HTTP/1.0");
    client.println("Host: simpletwitter.herokuapp.com");
    client.println();
  } else {
    Serial.println("Error.");
  }
  
  String sBuffer;
  
  while (client.connected()) {
    if(client.available()) {
      sBuffer += (char) client.read();
      
      //Serial.print(c);
    }
  }
    
  //Serial.println(buffer);
  Serial.println();
  Serial.println("Disconnecting.");
  client.stop();
  
  tweetBuffer = sBuffer.substring(sBuffer.indexOf("\r\n\r\n") + 4);
 
}

String getTweetfromBody(byte num) {
  
  int startIndex = 0;
  while(num > 0) {
      startIndex = tweetBuffer.indexOf("\n", startIndex) + 1;
      //Serial.println(startIndex);
      num--;
  }
  int startSearch = tweetBuffer.indexOf(" ", startIndex) + 1;
  int endSearch = tweetBuffer.indexOf("\n", startIndex);
  String tweet = tweetBuffer.substring(startSearch, endSearch);
  //Serial.println(tweet);
  return tweet;
}



void newTweetTone() {
  tone(8, 2000, DELAY);
  delay(DELAY);
  tone(8, 2200, DELAY);
  delay(DELAY);
  tone(8, 2400, DELAY);
  delay(DELAY);
  
  delay(DELAY);
  tone(8, 2400, DELAY);
  delay(DELAY);
}
